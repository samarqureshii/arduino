 int counter = 0;
int state = 0;
int laststate = 0;
int inPin = 2;
int trigPin = 5;
int echoPin = 6;
int leftMotor_forward = 9;
int leftMotor_backward = 10;
int rightMotor_forward = 11;
int rightMotor_backward = 12;
long duration;
int distance;

void setup() {
  pinMode(trigPin, OUTPUT);
  pinMode(echoPin, INPUT);
  Serial.begin(9600);
  pinMode(leftMotor_forward, OUTPUT);
  pinMode(leftMotor_backward, OUTPUT);
  pinMode(rightMotor_forward,OUTPUT);
  pinMode(rightMotor_backward, OUTPUT);
}

void backward(int duration){
  digitalWrite(leftMotor_forward, LOW);
  digitalWrite(leftMotor_backward, HIGH);
  digitalWrite(rightMotor_forward, LOW);
  digitalWrite(rightMotor_backward, HIGH);
  delay(duration);
}

void Stop (int duration){
  digitalWrite(leftMotor_forward,LOW);
  digitalWrite(leftMotor_backward,LOW);
  digitalWrite(rightMotor_forward, LOW);
  digitalWrite(rightMotor_backward, LOW);
  delay(duration);
}

void pivotLeft(int pivotDuration){
  digitalWrite(leftMotor_forward,LOW);
  digitalWrite(leftMotor_backward,HIGH);
  digitalWrite(rightMotor_forward, HIGH);
  digitalWrite(rightMotor_backward, LOW);
  delay(pivotDuration);
}

void pivotRight(int pivotDuration){
  digitalWrite(leftMotor_forward,HIGH);
  digitalWrite(leftMotor_backward,LOW);
  digitalWrite(rightMotor_forward, LOW);
  digitalWrite(rightMotor_backward, HIGH);
  delay(pivotDuration);
}

void counter(){
   if (state!= laststate){
    if (state == HIGH){
      counter++;
    }
  }delay(50);
}

void loop() { 
  digitalWrite(trigPin, LOW);
  delayMicroseconds(1000);
  digitalWrite(trigPin, HIGH);
  delayMicroseconds(1000);
  digitalWrite(trigPin, LOW);
  duration = pulseIn(echoPin, HIGH);
  distance = duration*0.034/2;
  Serial.print("Distance:");
  Serial.println(distance);
  state = digitalRead(inPin);
  if (state!= laststate){
    if (state == HIGH){
      counter++;
    }
  }delay(50);
  laststate = state;
  if (distance <= 10 ){
  pivotRight(7000);
  counter ++;
  }
  else if(distance <= 10){
    pivotLeft(7000);
    
  }
  
  else if (distance > 10){
    Stop(2);
  }
  

}


